// SPDX-License-Identifier: GPL-2.0-only
/*
 * Copyright (c) 2019, The Linux Foundation. All rights reserved.
 * Copyright (C) 2021 XiaoMi, Inc.
 *
 * K6 NVT 5020 mAh discharge OCV curves from the Android sweet battery profile.
 * Source: LineageOS/android_kernel_xiaomi_sm6150, lineage-23.2,
 * batterydata-K6-nvt-5020mah.dtsi, qcom,pc-temp-v2-lut.
 * Convert deci-uV to uV and hundredths of a percent to percent.
 * A replacement BN53 carrying an ATL/Ningde label uses this as a reference;
 * this does not authenticate its cell or establish its remaining capacity.
 * These curves do not change charging voltage, current or thermal limits.
 */

&battery {
	charge-full-design-microamp-hours = <5020000>;
	ocv-capacity-celsius = <(-10) 0 10 25 40 50>;

	/* -10 degrees Celsius. */
	ocv-capacity-table-0 =
		<4435500 100>,
		<4404200 98>,
		<4375700 96>,
		<4350600 94>,
		<4329000 92>,
		<4307500 90>,
		<4284400 88>,
		<4260500 86>,
		<4236400 84>,
		<4211700 82>,
		<4187100 80>,
		<4163300 78>,
		<4139900 76>,
		<4115900 74>,
		<4091400 72>,
		<4066400 70>,
		<4039900 68>,
		<4012400 66>,
		<3987500 64>,
		<3966100 62>,
		<3946300 60>,
		<3927200 58>,
		<3909200 56>,
		<3892100 54>,
		<3876100 52>,
		<3860800 50>,
		<3845500 48>,
		<3829800 46>,
		<3817700 44>,
		<3809700 42>,
		<3803500 40>,
		<3797400 38>,
		<3791700 36>,
		<3786000 34>,
		<3780400 32>,
		<3774800 30>,
		<3768800 28>,
		<3762500 26>,
		<3755500 24>,
		<3747800 22>,
		<3739200 20>,
		<3730400 18>,
		<3721400 16>,
		<3712600 14>,
		<3704300 12>,
		<3696400 10>,
		<3692100 9>,
		<3687400 8>,
		<3682500 7>,
		<3677500 6>,
		<3671800 5>,
		<3662800 4>,
		<3644400 3>,
		<3605800 2>,
		<3530900 1>,
		<3435800 0>;

	/* 0 degrees Celsius. */
	ocv-capacity-table-1 =
		<4434500 100>,
		<4403100 98>,
		<4374600 96>,
		<4349400 94>,
		<4327500 92>,
		<4305500 90>,
		<4281400 88>,
		<4256600 86>,
		<4231700 84>,
		<4206300 82>,
		<4182100 80>,
		<4160000 78>,
		<4138800 76>,
		<4117700 74>,
		<4096600 72>,
		<4074800 70>,
		<4051800 68>,
		<4027500 66>,
		<4002000 64>,
		<3974500 62>,
		<3949000 60>,
		<3927400 58>,
		<3908100 56>,
		<3889900 54>,
		<3873200 52>,
		<3857000 50>,
		<3840000 48>,
		<3824000 46>,
		<3813100 44>,
		<3805300 42>,
		<3799100 40>,
		<3794100 38>,
		<3789900 36>,
		<3785400 34>,
		<3781000 32>,
		<3776300 30>,
		<3771300 28>,
		<3765900 26>,
		<3759400 24>,
		<3751700 22>,
		<3742900 20>,
		<3732500 18>,
		<3720300 16>,
		<3706000 14>,
		<3691700 12>,
		<3679500 10>,
		<3675300 9>,
		<3672100 8>,
		<3668600 7>,
		<3665000 6>,
		<3658700 5>,
		<3637500 4>,
		<3582900 3>,
		<3498700 2>,
		<3362700 1>,
		<3218000 0>;

	/* 10 degrees Celsius. */
	ocv-capacity-table-2 =
		<4433000 100>,
		<4404600 98>,
		<4378100 96>,
		<4353900 94>,
		<4332000 92>,
		<4309600 90>,
		<4285400 88>,
		<4260600 86>,
		<4235700 84>,
		<4210700 82>,
		<4186000 80>,
		<4161900 78>,
		<4138300 76>,
		<4115100 74>,
		<4092600 72>,
		<4071300 70>,
		<4052300 68>,
		<4033100 66>,
		<4010700 64>,
		<3985500 62>,
		<3961000 60>,
		<3936600 58>,
		<3914100 56>,
		<3895400 54>,
		<3879200 52>,
		<3864400 50>,
		<3850800 48>,
		<3838400 46>,
		<3827400 44>,
		<3817300 42>,
		<3807700 40>,
		<3798100 38>,
		<3790200 36>,
		<3785200 34>,
		<3781400 32>,
		<3777300 30>,
		<3773200 28>,
		<3768500 26>,
		<3762500 24>,
		<3755200 22>,
		<3746200 20>,
		<3734300 18>,
		<3720200 16>,
		<3703500 14>,
		<3687600 12>,
		<3677500 10>,
		<3674100 9>,
		<3670700 8>,
		<3665800 7>,
		<3656100 6>,
		<3634200 5>,
		<3587900 4>,
		<3521300 3>,
		<3418200 2>,
		<3249800 1>,
		<2762800 0>;

	/* 25 degrees Celsius. */
	ocv-capacity-table-3 =
		<4431500 100>,
		<4404100 98>,
		<4378100 96>,
		<4354100 94>,
		<4332000 92>,
		<4309400 90>,
		<4285500 88>,
		<4261100 86>,
		<4236500 84>,
		<4211700 82>,
		<4187300 80>,
		<4163100 78>,
		<4139400 76>,
		<4116400 74>,
		<4094000 72>,
		<4072300 70>,
		<4051300 68>,
		<4030900 66>,
		<4012100 64>,
		<3994300 62>,
		<3974000 60>,
		<3948400 58>,
		<3923000 56>,
		<3902500 54>,
		<3884400 52>,
		<3869200 50>,
		<3856500 48>,
		<3845300 46>,
		<3835100 44>,
		<3825700 42>,
		<3817000 40>,
		<3808900 38>,
		<3801300 36>,
		<3794300 34>,
		<3787700 32>,
		<3780800 30>,
		<3773700 28>,
		<3766300 26>,
		<3758600 24>,
		<3750600 22>,
		<3742100 20>,
		<3732800 18>,
		<3720700 16>,
		<3706000 14>,
		<3692700 12>,
		<3686900 10>,
		<3685600 9>,
		<3683600 8>,
		<3680600 7>,
		<3673000 6>,
		<3648100 5>,
		<3597000 4>,
		<3530700 3>,
		<3437200 2>,
		<3293300 1>,
		<2759600 0>;

	/* 40 degrees Celsius. */
	ocv-capacity-table-4 =
		<4427500 100>,
		<4400500 98>,
		<4374900 96>,
		<4351300 94>,
		<4329500 92>,
		<4307200 90>,
		<4283500 88>,
		<4259300 86>,
		<4234900 84>,
		<4210200 82>,
		<4185800 80>,
		<4161900 78>,
		<4138300 76>,
		<4115300 74>,
		<4092800 72>,
		<4071200 70>,
		<4050400 68>,
		<4030400 66>,
		<4011800 64>,
		<3994000 62>,
		<3974500 60>,
		<3951200 58>,
		<3927700 56>,
		<3906800 54>,
		<3887400 52>,
		<3871700 50>,
		<3859100 48>,
		<3848200 46>,
		<3837900 44>,
		<3828400 42>,
		<3819900 40>,
		<3812400 38>,
		<3805200 36>,
		<3798300 34>,
		<3791600 32>,
		<3783700 30>,
		<3774200 28>,
		<3764400 26>,
		<3755300 24>,
		<3746200 22>,
		<3737100 20>,
		<3728100 18>,
		<3716300 16>,
		<3701600 14>,
		<3689800 12>,
		<3685200 10>,
		<3684300 9>,
		<3683000 8>,
		<3680600 7>,
		<3674100 6>,
		<3646800 5>,
		<3597800 4>,
		<3533600 3>,
		<3444600 2>,
		<3309800 1>,
		<2829700 0>;

	/* 50 degrees Celsius. */
	ocv-capacity-table-5 =
		<4427000 100>,
		<4399700 98>,
		<4374100 96>,
		<4350500 94>,
		<4328900 92>,
		<4306900 90>,
		<4283400 88>,
		<4259200 86>,
		<4234900 84>,
		<4210300 82>,
		<4186000 80>,
		<4162100 78>,
		<4138600 76>,
		<4115600 74>,
		<4093100 72>,
		<4071400 70>,
		<4050400 68>,
		<4030300 66>,
		<4011700 64>,
		<3994300 62>,
		<3975300 60>,
		<3952900 58>,
		<3930000 56>,
		<3909200 54>,
		<3889300 52>,
		<3873200 50>,
		<3860400 48>,
		<3849300 46>,
		<3838800 44>,
		<3829100 42>,
		<3820400 40>,
		<3812700 38>,
		<3805400 36>,
		<3798300 34>,
		<3791300 32>,
		<3782700 30>,
		<3771400 28>,
		<3760000 26>,
		<3750400 24>,
		<3741500 22>,
		<3732400 20>,
		<3723400 18>,
		<3711700 16>,
		<3696300 14>,
		<3684700 12>,
		<3680200 10>,
		<3679200 9>,
		<3677800 8>,
		<3675400 7>,
		<3668400 6>,
		<3639300 5>,
		<3590900 4>,
		<3527000 3>,
		<3438600 2>,
		<3305600 1>,
		<2913800 0>;
};
